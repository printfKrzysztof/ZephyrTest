## build/Kconfig/arch/Kconfig
```kconfig
# Load arch Kconfig descriptions.
osource "/home/krzysztof/zephyrproject/zephyr/arch/x86/Kconfig"
osource "/home/krzysztof/zephyrproject/zephyr/arch/xtensa/Kconfig"
osource "/home/krzysztof/zephyrproject/zephyr/arch/sparc/Kconfig"
osource "/home/krzysztof/zephyrproject/zephyr/arch/riscv/Kconfig"
osource "/home/krzysztof/zephyrproject/zephyr/arch/posix/Kconfig"
osource "/home/krzysztof/zephyrproject/zephyr/arch/nios2/Kconfig"
osource "/home/krzysztof/zephyrproject/zephyr/arch/mips/Kconfig"
osource "/home/krzysztof/zephyrproject/zephyr/arch/arm64/Kconfig"
osource "/home/krzysztof/zephyrproject/zephyr/arch/arm/Kconfig"
osource "/home/krzysztof/zephyrproject/zephyr/arch/arc/Kconfig"
```
